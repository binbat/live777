## product/rv1126b/configs/binbat_rv1126b_defconfig
```kconfig
# binbat RV1126B 产品 defconfig(buildroot 2025.02.6)
# 原则:产品极简——busybox init + dropbear + dhcp + v4l2 调试工具;
# ko/mpp/rkaiq/live777/iqfiles 全部走 overlay,不进 buildroot 包体系。
BR2_aarch64=y
BR2_KERNEL_HEADERS_6_1=y
BR2_PACKAGE_GLIBC_KERNEL_COMPAT=y
BR2_GCC_VERSION_13_X=y
BR2_TOOLCHAIN_BUILDROOT_CXX=y
BR2_PRIMARY_SITE="https://sources.buildroot.net"
BR2_GNU_MIRROR="https://mirrors.ustc.edu.cn/gnu"

BR2_TARGET_GENERIC_HOSTNAME="runcam"
BR2_TARGET_GENERIC_ISSUE="binbat rv1126b camera [root:luckfox]"
BR2_TARGET_GENERIC_ROOT_PASSWD="luckfox"
BR2_ROOTFS_DEVICE_CREATION_DYNAMIC_EUDEV=y
BR2_SYSTEM_BIN_SH_BASH=y
BR2_ENABLE_LOCALE_WHITELIST="en_US C"
BR2_TARGET_TZ_INFO=y

BR2_PACKAGE_BUSYBOX_CONFIG_FRAGMENT_FILES="$(BR2_EXTERNAL_BINBAT_RV1126B_PATH)/board/rv1126b/busybox.fragment"
BR2_PACKAGE_BUSYBOX_SHOW_OTHERS=y

# SSH(产品用 dropbear,比 openssh 小一个量级)
BR2_PACKAGE_DROPBEAR=y
BR2_PACKAGE_DROPBEAR_CLIENT=y

# 网络
BR2_PACKAGE_DHCPCD=y
BR2_PACKAGE_IPROUTE2=y
BR2_PACKAGE_IPERF3=y
BR2_PACKAGE_WGET=y
BR2_PACKAGE_PHYTOOL=y

# 摄像头调试/排障(产品上也有用)
BR2_PACKAGE_V4L2_UTILS=y
BR2_PACKAGE_DTC=y
BR2_PACKAGE_DTC_PROGRAMS=y

# 基础工具
BR2_PACKAGE_GZIP=y
BR2_PACKAGE_XZ=y
BR2_PACKAGE_NANO=y
BR2_PACKAGE_LIBCURL=y
BR2_PACKAGE_LIBCURL_CURL=y

# 只出 tar;ext4 由 scripts/pack-rootfs.sh 打(和 SDK 分区/刷机流程对齐)
BR2_TARGET_ROOTFS_TAR=y

# 我们的 overlay
BR2_ROOTFS_OVERLAY="$(BR2_EXTERNAL_BINBAT_RV1126B_PATH)/board/rv1126b/overlay"
```
